/**
 * @cliArgs --board "/boards/LAUNCHXL_F280025C" --context "system" --product "C2000WARE@5.01.00.00"
 * @versions {"tool":"1.16.1+2960"}
 */

/**
 * Import the modules used in this configuration.
 */
const eqep  = scripting.addModule("/driverlib/eqep.js", {}, false);
const eqep1 = eqep.addInstance();
const gpio  = scripting.addModule("/driverlib/gpio.js", {}, false);
const gpio1 = gpio.addInstance();
const gpio2 = gpio.addInstance();
const gpio3 = gpio.addInstance();

/**
 * Write custom configuration values to the imported modules.
 */
eqep1.$name                   = "Rail_enc";
eqep1.eqepResolution          = "EQEP_CONFIG_1X_RESOLUTION";
eqep1.positionCounterMax      = 3999;
eqep1.enableModule            = true;
eqep1.useCase                 = "NO STROBE";
eqep1.positionIndexEvents     = "EQEP_INIT_RISING_INDEX";
eqep1.enableUnitTimer         = true;
eqep1.latchPositionCounter    = "EQEP_LATCH_UNIT_TIME_OUT";
eqep1.emulationMode           = "EQEP_EMULATIONMODE_RUNFREE";
eqep1.registerInterrupts      = true;
eqep1.enableInterrupt         = true;
eqep1.interruptSources        = ["EQEP_INT_UNIT_TIME_OUT"];
eqep1.$hardware               = system.deviceData.board.components.EQEP1_HEADER;
eqep1.unitTimerPeriod         = 10000;
eqep1.eqepInt.enableInterrupt = true;

gpio1.$hardware = system.deviceData.board.components.LED4;
gpio1.$name     = "LED4_pin";
gpio1.direction = "GPIO_DIR_MODE_OUT";

gpio2.$name     = "LED5_pin";
gpio2.$hardware = system.deviceData.board.components.LED5;
gpio2.direction = "GPIO_DIR_MODE_OUT";

gpio3.$name             = "Test_pin0";
gpio3.direction         = "GPIO_DIR_MODE_OUT";
gpio3.writeInitialValue = true;

/**
 * Pinmux solution for unlocked pins/peripherals. This ensures that minor changes to the automatic solver in a future
 * version of the tool will not impact the pinmux you originally saw.  These lines can be completely deleted in order to
 * re-solve from scratch.
 */
eqep1.eqep.$suggestSolution               = "EQEP1";
eqep1.eqep.eqep_aPin.$suggestSolution     = "boosterpack2.50";
eqep1.eqep.eqep_bPin.$suggestSolution     = "boosterpack2.49";
eqep1.eqep.eqep_indexPin.$suggestSolution = "boosterpack1.9";
gpio1.gpioPin.$suggestSolution            = "boosterpack2.54";
gpio2.gpioPin.$suggestSolution            = "boosterpack1.8";
gpio3.gpioPin.$suggestSolution            = "boosterpack1.11";
